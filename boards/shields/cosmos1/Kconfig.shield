## boards/shields/cosmos1/Kconfig.shield
```kconfig
config SHIELD_COSMOS1_LEFT
    def_bool $(shields_list_contains,cosmos1_left)

config SHIELD_COSMOS1_RIGHT
    def_bool $(shields_list_contains,cosmos1_right)
```

## boards/shields/dcamp_cosmos1/Kconfig.defconfig
```kconfig
if SHIELD_DCAMP_COSMOS1_LEFT

config ZMK_KEYBOARD_NAME
    default "dcamp_cosmos1"

config ZMK_SPLIT_ROLE_CENTRAL
    default y

endif # SHIELD_DCAMP_COSMOS1_LEFT

if SHIELD_DCAMP_COSMOS1_LEFT || SHIELD_DCAMP_COSMOS1_RIGHT

config ZMK_SPLIT
    default y

endif # SHIELD_DCAMP_COSMOS1_LEFT || SHIELD_DCAMP_COSMOS1_RIGHT
```

## boards/shields/dcamp_cosmos1/Kconfig.shield
```kconfig
config SHIELD_DCAMP_COSMOS1_LEFT
    def_bool $(shields_list_contains,dcamp_cosmos1_left)

config SHIELD_DCAMP_COSMOS1_RIGHT
    def_bool $(shields_list_contains,dcamp_cosmos1_right)
```
